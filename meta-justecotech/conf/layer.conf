## meta-justecotech/conf/layer.conf
```bitbake
# We have a conf and classes directory, add to BBPATH
BBPATH .= ":${LAYERDIR}"

BBFILE_COLLECTIONS += "justecotech"
BBFILE_PATTERN_justecotech = ""
LAYERVERSION_justecotech = "1"
LAYERSERIES_COMPAT_justecotech = "thud warrior"

# Provide a variable that points the base of the justecotech layer.
JUSTECOTECHBASE = '${@os.path.normpath("${LAYERDIR}/")}'
```

## meta-justecotech/meta-justeco/conf/machine/justeco.conf
```bitbake
KMACHINE = "aspeed"
KERNEL_DEVICETREE = "${KMACHINE}-bmc-${MACHINE}.dtb"

UBOOT_MACHINE = "ast_g5_phy_config"
FLASH_SIZE = "32768"

VIRTUAL-RUNTIME_skeleton_workbook = "${MACHINE}-config"

SERIAL_CONSOLES = "115200;ttyS4"

require conf/machine/include/ast2500.inc
require conf/machine/include/obmc-bsp-common.inc
require conf/machine/include/justecotech.inc

PHOSPHOR_MRW_LICENSE = "Apache-2.0"
PHOSPHOR_MRW_LIC_FILES_CHKSUM = "file://LICENSE;md5=e3fc50a88d0a364313df4b21ef20c29e"
#PHOSPHOR_MRW_URI = "git://github.com/open-power/romulus-xml"
#PHOSPHOR_MRW_REV = "14b471fbf37f5fb60261de001df83caf5f96d81f"
```
